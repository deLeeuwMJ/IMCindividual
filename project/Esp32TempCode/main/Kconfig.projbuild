## project/Esp32TempCode/main/Kconfig.projbuild
```kconfig
menu "esp32-i2c-lcd1602-example Configuration"

config I2C_MASTER_SCL
    int "I2C Master SCL GPIO number"
	range 0 34
	default 23
	help
		GPIO number (IOxx) for I2C SCL.

		Some GPIOs are used for other purposes (flash connections, etc.) and cannot be used.

		GPIOs 35-39 are input-only so cannot be used to drive the One Wire Bus.

config I2C_MASTER_SDA
    int "I2C Master SDA GPIO number"
    range 0 34
    default 18
    help
        GPIO number (IOxx) for I2C SDA.

        Some GPIOs are used for other purposes (flash connections, etc.) and cannot be used.

        GPIOs 35-39 are input-only so cannot be used to drive the One Wire Bus.

config LCD1602_I2C_ADDRESS
    hex "I2C Address for LCD1602 device"
    default 0x27
    help
        I2C address for HD44780-compatible LCD1602 device.

config WIFI_SSID
    string "WiFi SSID"
	default "eduroam"
	help
		SSID (network name) for the example to connect to.
		

config WIFI_IDENTITY
    string "WiFi Identity"
	default "mylogin@avans.nl"
	help
		WiFi Identity for eduroam

		Can be left blank if you don't want to connect to eduroam

config WIFI_PASSWORD
    string "WiFi Password"
	default "mypassword"
	help
		WiFi password (WPA or WPA2) for the example to use.

		Can be left blank if the network has no security set.


endmenu
```
